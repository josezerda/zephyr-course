## CMakeLists.txt
```
cmake_minimum_required(VERSION 3.20.0)

list(APPEND ZEPHYR_EXTRA_MODULES ${CMAKE_CURRENT_SOURCE_DIR}/../drivers)

function(app_set_runner_args)
  board_runner_args(stm32cubeprogrammer "--extload=MX25UW25645G_NUCLEO-H7S3L8.stldr")
endfunction()

find_package(Zephyr REQUIRED)
project(my_zephyr_app)

target_sources(app PRIVATE src/main.cpp src/sensor_shell.c)
```

## Kconfig
```
source "Kconfig.zephyr"

config APP_HEARTBEAT_PERIOD_MS
    int "Heartbeat LED blink period (ms)"
    default 500
    range 100 2000

menuconfig LED_SUBSYSTEM
    bool "LED Subsystem"
    default y

if LED_SUBSYSTEM

choice LED_BLINK_SLEEP
    prompt "LED blink sleep time"
    default LED_BLINK_1S

config LED_BLINK_250MS
    bool "250ms (fast)"

config LED_BLINK_500MS
    bool "500ms (slow)"

config LED_BLINK_1S
    bool "1s (medium)"

config LED_BLINK_2S
    bool "2s (very slow)"

endchoice

config LED_BLINK_SLEEP_MS
    int
    default 250  if LED_BLINK_250MS
    default 500  if LED_BLINK_500MS
    default 1000 if LED_BLINK_1S
    default 2000 if LED_BLINK_2S

menuconfig LED_ADVANCED
    bool "Advanced LED settings"

if LED_ADVANCED

config LED_BRIGHTNESS
    int "LED brightness (0-100)"
    range 0 100
    default 100

config LED_FADE_TIME
    int "LED fade duration (ms)"
    range 0 5000
    default 500

menu "Expert settings"
    visible if LED_ADVANCED

config LED_EXPERT_ENABLE
    bool "Enable LED debugging"

config LED_CUSTOM
    bool "Custom blink pattern"

endmenu

endif # LED_ADVANCED
endif # LED_SUBSYSTEM
```

## prj.conf
```kconfig
CONFIG_GPIO=y
CONFIG_LOG=y
CONFIG_LOG_DEFAULT_LEVEL=3
CONFIG_LED_SUBSYSTEM=y
CONFIG_LED_BLINK_1S=y
CONFIG_LED_ADVANCED=y
CONFIG_LED_BRIGHTNESS=100
CONFIG_LED_FADE_TIME=500
CONFIG_SENSOR=y
CONFIG_LED_SENSOR=y
CONFIG_SHELL=y
```

## app.overlay
```dts
/ {
	aliases {
		app-led = &green_led;
	};

	led_sensor: led-sensor {
		compatible = "custom,led-sensor";
		gpios = <&gpiod 10 GPIO_ACTIVE_HIGH>;
		status = "okay";
	};
};
```

## src/main.cpp
```c
#include <zephyr/kernel.h>
#include <zephyr/drivers/sensor.h>
#include <zephyr/logging/log.h>

#include "led_sensor.h"

LOG_MODULE_REGISTER(led_app, LOG_LEVEL_DBG);

int main(void)
{
    const struct device *dev = DEVICE_DT_GET(DT_NODELABEL(led_sensor));

    if (!device_is_ready(dev)) {
        LOG_ERR("LED sensor not ready");
        return -ENODEV;
    }

    LOG_INF("LED sensor driver demo starting...");
    LOG_INF("Blink period: %d ms", CONFIG_APP_HEARTBEAT_PERIOD_MS);

    /* Extension API: reset the blink_count in the driver's data struct */
    led_sensor_set_blink_count(dev, 0);
    LOG_INF("blink_count reset via extension API");

    while (1) {
        struct sensor_value val;

        sensor_sample_fetch(dev);
        LOG_DBG("LED ON");
        k_msleep(CONFIG_APP_HEARTBEAT_PERIOD_MS);

        sensor_channel_get(dev, SENSOR_CHAN_ALL, &val);
        LOG_INF("LED OFF — blink_count: %d", val.val1);
        k_msleep(CONFIG_APP_HEARTBEAT_PERIOD_MS);
    }

    return 0;
}
```

## src/sensor_shell.c
```c
#include <zephyr/device.h>
#include <zephyr/drivers/sensor.h>
#include <zephyr/shell/shell.h>

#include "led_sensor.h"

#define BLINK_COUNT_MAX  100000U

static const struct device *const sensor_dev =
	DEVICE_DT_GET(DT_NODELABEL(led_sensor));

static int cmd_sensor_fetch(const struct shell *sh, size_t argc, char **argv)
{
	int ret = sensor_sample_fetch(sensor_dev);

	if (ret) {
		shell_error(sh, "sensor_sample_fetch failed: %d", ret);
		return ret;
	}

	shell_print(sh, "fetch OK — LED on");
	return 0;
}

static int cmd_sensor_read(const struct shell *sh, size_t argc, char **argv)
{
	struct sensor_value val;
	int ret = sensor_channel_get(sensor_dev, SENSOR_CHAN_ALL, &val);

	if (ret) {
		shell_error(sh, "sensor_channel_get failed: %d", ret);
		return ret;
	}

	shell_print(sh, "LED off — blink_count: %d", val.val1);
	return 0;
}

static int cmd_sensor_info(const struct shell *sh, size_t argc, char **argv)
{
	shell_print(sh, "device : %s", sensor_dev->name);
	shell_print(sh, "ready  : %s", device_is_ready(sensor_dev) ? "yes" : "no");
	return 0;
}

static int cmd_sensor_set(const struct shell *sh, size_t argc, char **argv)
{
	int err = 0;
	unsigned long val = shell_strtoul(argv[1], 10, &err);

	if (err) {
		shell_error(sh, "invalid value '%s': must be a non-negative integer", argv[1]);
		return -EINVAL;
	}

	if (val > BLINK_COUNT_MAX) {
		shell_error(sh, "value out of range — must be 0..%u", BLINK_COUNT_MAX);
		return -ERANGE;
	}

	int ret = led_sensor_set_blink_count(sensor_dev, (uint32_t)val);

	if (ret) {
		shell_error(sh, "set_blink_count failed: %d", ret);
		return ret;
	}

	shell_print(sh, "blink_count set to %lu", val);
	return 0;
}

SHELL_STATIC_SUBCMD_SET_CREATE(sub_sensor,
	SHELL_CMD(fetch, NULL, "Call sensor_sample_fetch (LED on)",  cmd_sensor_fetch),
	SHELL_CMD(read,  NULL, "Call sensor_channel_get (LED off, print blink_count)", cmd_sensor_read),
	SHELL_CMD(info,  NULL, "Print device name and ready state",  cmd_sensor_info),
	SHELL_CMD_ARG(set, NULL, "Set blink_count <value> [0.." STRINGIFY(BLINK_COUNT_MAX) "]",
		      cmd_sensor_set, 2, 0),
	SHELL_SUBCMD_SET_END
);

SHELL_CMD_REGISTER(sensor, &sub_sensor, "LED sensor commands", NULL);
```
