## boards/my_nucleo_h7s3l8/Kconfig.defconfig
```kconfig
# STM32H7S3L8 NUCLEO board configuration
#
# Copyright (c) 2024 STMicroelectronics
#
# SPDX-License-Identifier: Apache-2.0

if BOARD_MY_NUCLEO_H7S3L8

configdefault NET_L2_ETHERNET
	default y

endif # BOARD_MY_NUCLEO_H7S3L8
```

## boards/my_nucleo_h7s3l8/Kconfig.my_nucleo_h7s3l8
```kconfig
# Copyright (c) 2024 STMicroelectronics
# SPDX-License-Identifier: Apache-2.0

config BOARD_MY_NUCLEO_H7S3L8
	select SOC_STM32H7S3XX
```

## boards/my_scratch_board/board.yml
```yaml
board:
  name: my_scratch_board
  full_name: My Custom Board From Scratch
  vendor: st
  socs:
    - name: stm32h7s3xx
```
